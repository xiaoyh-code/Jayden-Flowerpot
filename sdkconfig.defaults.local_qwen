## sdkconfig.defaults.local_qwen
```kconfig
# XIAO ESP32S3 Sense local Qwen camera configuration. No credentials here.
CONFIG_PARTITION_TABLE_CUSTOM=y
CONFIG_PARTITION_TABLE_CUSTOM_FILENAME="partitions_8mb_ota.csv"
CONFIG_ESP_CONSOLE_USB_SERIAL_JTAG=y
CONFIG_ESPCLAW_CAMERA_SENSE=y
CONFIG_ESPCLAW_LLM_BACKEND_CUSTOM=y
CONFIG_ESPCLAW_LLM_MODEL="qwen3.8-27b"
CONFIG_ESPCLAW_CHANNEL_SERIAL=y
CONFIG_ESPCLAW_CHANNEL_HTTP=y
CONFIG_ESPCLAW_CHANNEL_MQTT=n
CONFIG_ESPCLAW_CHANNEL_TELEGRAM=n
CONFIG_ESPCLAW_CHANNEL_DISCORD=n
CONFIG_ESPCLAW_CHANNEL_SLACK=n
CONFIG_ESPCLAW_CHANNEL_DINGTALK=n
CONFIG_ESPCLAW_CHANNEL_WECOM=n
CONFIG_ESPCLAW_CHANNEL_LARK=n
CONFIG_ESPCLAW_CHANNEL_PUSHPLUS=n
CONFIG_ESPCLAW_CHANNEL_BARK=n
CONFIG_LOG_DEFAULT_LEVEL_INFO=y
CONFIG_LOG_DEFAULT_LEVEL=3
```
